## conf/layer.conf
```bitbake
# We have a conf and classes directory, add to BBPATH
BBPATH .= ":${LAYERDIR}"

# We have recipes-* directories, add to BBFILES
BBFILES += "${LAYERDIR}/recipes-*/*/*.bb \
            ${LAYERDIR}/recipes-*/*/*.bbappend"

BBFILE_COLLECTIONS += "meta-squashfs-overlayfs-rpi"
BBFILE_PATTERN_meta-squashfs-overlayfs-rpi = "^${LAYERDIR}/"
BBFILE_PRIORITY_meta-squashfs-overlayfs-rpi = "10"

LAYERDEPENDS_meta-squashfs-overlayfs-rpi = "core"
LAYERSERIES_COMPAT_meta-squashfs-overlayfs-rpi = "kirkstone"
```

## wic/rpi-sdimage-with-squashfs.wks
```
# Boot partition.
part /boot --source bootimg-partition --ondisk mmcblk0 --fstype=vfat --label boot --active --align 4096 --size 20

# Squashfs root partition.
part / --source rootfs --ondisk mmcblk0 --fstype=squashfs

# Data partition used for overlayfs.
part /data --ondisk mmcblk0  --fstype=ext2 --size=256M
```
